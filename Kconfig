## Kconfig
```kconfig
config SENSOR_ID
    string "Sensor ID"
    default "sensor_default"

config BEARER_TOKEN
    string "Bearer Token"
    default "token_default"
```

## sdkconfig.defaults
```kconfig
CONFIG_ESPTOOLPY_FLASHSIZE_4MB=y
CONFIG_ESPTOOLPY_HEADER_FLASHSIZE_UPDATE=y
CONFIG_ESP_SYSTEM_PANIC_PRINT_REBOOT=y

# We saw this today: Error: The program size (1055286 bytes) is greater than maximum allowed (1048576 bytes)
# Disable unused components
CONFIG_BT_ENABLED=n
CONFIG_BLUEDROID_ENABLED=n
CONFIG_BTC_TASK_STACK_SIZE=0
CONFIG_ESP_CONSOLE_MULTIPLE_UART=n
CONFIG_ESP_CONSOLE_UART=n

# Increase stack sizes to prevent overflow
CONFIG_ESP_SYSTEM_EVENT_TASK_STACK_SIZE=3072
CONFIG_ESP_TIMER_TASK_STACK_SIZE=3072
CONFIG_FREERTOS_IDLE_TASK_STACKSIZE=1536
CONFIG_ESP_MAIN_TASK_STACK_SIZE=8192

# Enable stack overflow detection
CONFIG_FREERTOS_CHECK_STACKOVERFLOW_PTRVAL=y
CONFIG_FREERTOS_WATCHPOINT_END_OF_STACK=y


# Log levels
# CONFIG_LOG_DEFAULT_LEVEL_NONE=y (level 0)
# CONFIG_LOG_DEFAULT_LEVEL_ERROR=y (level 1)
# CONFIG_LOG_DEFAULT_LEVEL_WARN=y (level 2)
# CONFIG_LOG_DEFAULT_LEVEL_INFO=y (level 3)
# CONFIG_LOG_DEFAULT_LEVEL_DEBUG=y (level 4)
# CONFIG_LOG_DEFAULT_LEVEL_VERBOSE=y (level 5)

# Both of these are necessary for Kconfig and ESP-IDF
# CONFIG_LOG_DEFAULT_LEVEL_NONE=y
# CONFIG_LOG_DEFAULT_LEVEL=0
# Any log statements above this level are completely removed from the compiled binary
# CONFIG_LOG_MAXIMUM_LEVEL=0

CONFIG_LOG_DEFAULT_LEVEL_INFO=y
CONFIG_LOG_DEFAULT_LEVEL=3
# Any log statements above this level are completely removed from the compiled binary
CONFIG_LOG_MAXIMUM_LEVEL=3

CONFIG_PARTITION_TABLE_CUSTOM=y
CONFIG_PARTITION_TABLE_CUSTOM_FILENAME="partitions.csv"
CONFIG_PARTITION_TABLE_FILENAME="partitions.csv"
```

## sdkconfig.defaults_esp32c3_base
```kconfig
CONFIG_ESPTOOLPY_FLASHSIZE_4MB=y
CONFIG_ESPTOOLPY_HEADER_FLASHSIZE_UPDATE=y
CONFIG_ESP_SYSTEM_PANIC_PRINT_REBOOT=y

# We saw this today: Error: The program size (1055286 bytes) is greater than maximum allowed (1048576 bytes)
# Disable unused components
CONFIG_BT_ENABLED=n
CONFIG_BLUEDROID_ENABLED=n
CONFIG_BTC_TASK_STACK_SIZE=0
CONFIG_ESP_CONSOLE_MULTIPLE_UART=n
CONFIG_ESP_CONSOLE_UART=n

# Reduce memory usage
CONFIG_ESP_SYSTEM_EVENT_TASK_STACK_SIZE=2048
CONFIG_ESP_TIMER_TASK_STACK_SIZE=2048
CONFIG_FREERTOS_IDLE_TASK_STACKSIZE=768


# Log levels
# CONFIG_LOG_DEFAULT_LEVEL_NONE=y (level 0)
# CONFIG_LOG_DEFAULT_LEVEL_ERROR=y (level 1)
# CONFIG_LOG_DEFAULT_LEVEL_WARN=y (level 2)
# CONFIG_LOG_DEFAULT_LEVEL_INFO=y (level 3)
# CONFIG_LOG_DEFAULT_LEVEL_DEBUG=y (level 4)
# CONFIG_LOG_DEFAULT_LEVEL_VERBOSE=y (level 5)

# Both of these are necessary for Kconfig and ESP-IDF
CONFIG_LOG_DEFAULT_LEVEL_NONE=y
CONFIG_LOG_DEFAULT_LEVEL=0
# Any log statements above this level are completely removed from the compiled binary
CONFIG_LOG_MAXIMUM_LEVEL=0

# CONFIG_LOG_DEFAULT_LEVEL_INFO=y
# CONFIG_LOG_DEFAULT_LEVEL=3
# Any log statements above this level are completely removed from the compiled binary
# CONFIG_LOG_MAXIMUM_LEVEL=3

CONFIG_PARTITION_TABLE_CUSTOM=y
CONFIG_PARTITION_TABLE_CUSTOM_FILENAME="partitions.csv"
CONFIG_PARTITION_TABLE_FILENAME="partitions.csv"
```
